/* Copyright (c) Meta Platforms, Inc. and affiliates.
 * All rights reserved.
 *
 * This source code is licensed under the BSD-style license found in the
 * LICENSE file in the root directory of this source tree.
 */

/* This is an example ExecuTorch runner for Espressif ESP32 and ESP32-S3 chips.
 * It is inspired by the Arm Cortex-M example runner and adapted for the
 * ESP-IDF build system and ESP32 memory architecture.
 *
 * Some defines used to configure the code:
 *
 * ET_ESP_METHOD_ALLOCATOR_POOL_SIZE      - Size of memory area used when
 *                                          setting up the model.
 * ET_ESP_SCRATCH_TEMP_ALLOCATOR_POOL_SIZE - Size of memory area used when
 *                                           running inferences (scratch).
 * ET_NUM_INFERENCES  - Number of times to run the inference.
 * ET_LOG_DUMP_INPUT  - Control if you want input to be dumped to the log.
 * ET_LOG_DUMP_OUTPUT - Control if you want output to be dumped to the log.
 *
 * Devtool BundleIO: Use Bundle PTE with input and reference output included
 * to check if it matches.
 *
 * ET_BUNDLE_IO       - Build in Devtools BundleIO support. Makes it possible
 *                      to use bpte with bundled input and output ref data.
 *   ET_ATOL          - The atol used to compare output and ref data.
 *   ET_RTOL          - The rtol used to compare output and ref data.
 *
 * Devtools ETDump: Speed and dumping output
 *
 * ET_EVENT_TRACER_ENABLED       - Build in Devtools ETDump event trace code
 *                                 to generate cycle data.
 * ET_DUMP_OUTPUTS               - Collect and print outputs as a base64
 *                                 buffer in the log.
 * ET_DUMP_INTERMEDIATE_OUTPUTS  - Collect and print intermediate outputs.
 * ET_DEBUG_BUFFER_SIZE          - Override size of memory area used by
 *                                 ET_DUMP_OUTPUTS /
 * ET_DUMP_INTERMEDIATE_OUTPUTS.
 *
 * ESP32 Memory Notes:
 *   - ESP32 has ~520KB internal SRAM, optionally 4-8MB PSRAM.
 *   - ESP32-S3 has ~512KB internal SRAM, optionally 2-32MB PSRAM (octal).
 *   - For larger models, PSRAM is required. Memory pools are placed in
 *     PSRAM when available using EXT_RAM_BSS_ATTR.
 *   - The model .pte data is converted to a C array and compiled in,
 *     or can be loaded from SPIFFS/LittleFS/SD card filesystem.
 *
 * FILESYSTEM_LOAD - When defined, the runner will load the .pte model
 *                   from the filesystem (SPIFFS/LittleFS/SD) instead of
 *                   compiled-in data. Useful for larger models that don't
 *                   fit in flash as a C array.
 */

#include <errno.h>
#include <stdio.h>
#include <stdlib.h>
#include <algorithm>
#include <cinttypes>
#include <cstring>
#include <memory>
#include <type_traits>
#include <utility>
#include <vector>

#include <executorch/extension/data_loader/buffer_data_loader.h>
#include <executorch/extension/runner_util/inputs.h>
#include <executorch/runtime/core/exec_aten/util/scalar_type_util.h>
#include <executorch/runtime/core/memory_allocator.h>
#include <executorch/runtime/executor/program.h>
#include <executorch/runtime/platform/log.h>
#include <executorch/runtime/platform/platform.h>
#include <executorch/runtime/platform/runtime.h>

#include "esp_executor_runner.h"
#include "esp_memory_allocator.h"
#include "esp_perf_monitor.h"

#if defined(ESP_PLATFORM)
#include <esp_heap_caps.h>
#include <esp_log.h>
#include <esp_system.h>
#include <freertos/FreeRTOS.h>
#include <freertos/task.h>
#endif

#if defined(ET_BUNDLE_IO)
#include <executorch/devtools/bundled_program/bundled_program.h>
#endif

#if defined(ET_EVENT_TRACER_ENABLED)
#include <executorch/devtools/etdump/etdump_flatcc.h>

#if defined(ET_DUMP_INTERMEDIATE_OUTPUTS) || defined(ET_DUMP_OUTPUTS)
#include <executorch/devtools/etdump/data_sinks/buffer_data_sink.h>

#if !defined(ET_DEBUG_BUFFER_SIZE)
#define ET_DEBUG_BUFFER_SIZE (64 * 1024)
#endif

#endif // ET_DUMP_INTERMEDIATE_OUTPUTS || ET_DUMP_OUTPUTS

#endif // ET_EVENT_TRACER_ENABLED

#if defined(FILESYSTEM_LOAD)
#include <sys/stat.h>
#if defined(ESP_PLATFORM)
#include <esp_spiffs.h>
#endif
#else
/* When not loading from filesystem, include the model as a compiled-in
 * C array. This header is generated by the build process from the .pte file
 * specified in ET_PTE_FILE_PATH. */
#include "model_pte.h"
#endif

using executorch::aten::ScalarType;
using executorch::aten::Tensor;
using executorch::extension::BufferDataLoader;
using executorch::runtime::Error;
using executorch::runtime::EValue;
using executorch::runtime::HierarchicalAllocator;
using executorch::runtime::MemoryAllocator;
using executorch::runtime::MemoryManager;
using executorch::runtime::Method;
using executorch::runtime::MethodMeta;
using executorch::runtime::Program;
using executorch::runtime::Result;
using executorch::runtime::Span;
using executorch::runtime::Tag;
using executorch::runtime::TensorInfo;
using executorch::runtime::toString;

#if defined(ET_BUNDLE_IO)
using executorch::bundled_program::compute_method_output_error_stats;
using executorch::bundled_program::ErrorStats;
using executorch::bundled_program::verify_method_outputs;
#endif

#if defined(ET_EVENT_TRACER_ENABLED)
using executorch::etdump::BufferDataSink;
using executorch::etdump::ETDumpGen;
using executorch::etdump::ETDumpResult;
using executorch::runtime::EventTracerDebugLogLevel;
using torch::executor::etdump_result;
#endif

/**
 * Memory pool sizes for the ExecuTorch runtime.
 *
 * ESP32:    ~520KB internal SRAM total. With PSRAM: 4-8MB external.
 * ESP32-S3: ~512KB internal SRAM total. With PSRAM: 2-32MB external.
 *
 * For models that fit in internal SRAM, use smaller pool sizes.
 * For larger models, enable PSRAM and increase these values.
 *
 * Default: 256KB method allocator, 128KB scratch (suitable for small models).
 * With PSRAM: These can be increased significantly.
 */
#if !defined(ET_ESP_METHOD_ALLOCATOR_POOL_SIZE)
#if defined(CONFIG_SPIRAM)
/* With PSRAM available, use larger pools */
#define ET_ESP_METHOD_ALLOCATOR_POOL_SIZE (2 * 1024 * 1024)
#else
/* Internal SRAM only - conservative defaults */
#define ET_ESP_METHOD_ALLOCATOR_POOL_SIZE (256 * 1024)
#endif
#endif

#if !defined(ET_ESP_SCRATCH_TEMP_ALLOCATOR_POOL_SIZE)
#if defined(CONFIG_SPIRAM)
#define ET_ESP_SCRATCH_TEMP_ALLOCATOR_POOL_SIZE (512 * 1024)
#else
#define ET_ESP_SCRATCH_TEMP_ALLOCATOR_POOL_SIZE (128 * 1024)
#endif
#endif

/**
 * Memory pool placement.
 * On ESP32 with PSRAM, place large buffers in external RAM.
 * EXT_RAM_BSS_ATTR places the buffer in PSRAM .bss section.
 */
#if defined(CONFIG_SPIRAM) && defined(ESP_PLATFORM)
#include <esp_heap_caps.h>
// Use PSRAM for large allocations
static const size_t method_allocation_pool_size =
    ET_ESP_METHOD_ALLOCATOR_POOL_SIZE;
static uint8_t __attribute__((aligned(16)))
method_allocation_pool[ET_ESP_METHOD_ALLOCATOR_POOL_SIZE] EXT_RAM_BSS_ATTR;

static const size_t temp_allocation_pool_size =
    ET_ESP_SCRATCH_TEMP_ALLOCATOR_POOL_SIZE;
static uint8_t __attribute__((aligned(16)))
temp_allocation_pool[ET_ESP_SCRATCH_TEMP_ALLOCATOR_POOL_SIZE] EXT_RAM_BSS_ATTR;
#else
// Internal SRAM allocation
static const size_t method_allocation_pool_size =
    ET_ESP_METHOD_ALLOCATOR_POOL_SIZE;
static uint8_t __attribute__((
    aligned(16))) method_allocation_pool[ET_ESP_METHOD_ALLOCATOR_POOL_SIZE];

static const size_t temp_allocation_pool_size =
    ET_ESP_SCRATCH_TEMP_ALLOCATOR_POOL_SIZE;
static uint8_t __attribute__((
    aligned(16))) temp_allocation_pool[ET_ESP_SCRATCH_TEMP_ALLOCATOR_POOL_SIZE];
#endif

#if defined(FILESYSTEM_LOAD)
static char* model_pte = nullptr;
static size_t model_pte_size = 0;
#endif

#if defined(ET_BUNDLE_IO)
static const size_t testset_idx = 0;

#if defined(ET_ATOL)
static const float et_atol = ET_ATOL;
#else
static const float et_atol = 0.01;
#endif

#if defined(ET_RTOL)
static const float et_rtol = ET_RTOL;
#else
static const float et_rtol = 0.01;
#endif
#endif // ET_BUNDLE_IO

#if defined(ET_NUM_INFERENCES)
static const int num_inferences = ET_NUM_INFERENCES;
#else
static const int num_inferences = 10;
#endif

namespace {

/// Lightweight heapless container that constructs and stores a T in-place.
/// Useful when you want to avoid heap allocations but need to delay
/// construction.
template <typename T>
class Box {
 public:
  Box() = default;

  ~Box() {
    if (has_value) {
      ptr()->~T();
    }
  }

  Box(const Box&) = delete;
  Box& operator=(const Box&) = delete;

  template <typename... Args>
  void reset(Args&&... args) {
    if (has_value) {
      reinterpret_cast<T*>(mem)->~T();
    }
    new (mem) T(std::forward<Args>(args)...);
    has_value = true;
  }

  T& value() {
    return *ptr();
  }

  const T& value() const {
    return *ptr();
  }

  T* operator->() {
    return ptr();
  }

  const T* operator->() const {
    return ptr();
  }

 private:
  alignas(T) uint8_t mem[sizeof(T)];
  bool has_value = false;

  T* ptr() {
    return reinterpret_cast<T*>(mem);
  }

  const T* ptr() const {
    return reinterpret_cast<const T*>(mem);
  }
};

template <typename ValueType>
void fill_tensor_with_default_value(Tensor& tensor) {
  ValueType fill_value{};
  if constexpr (std::is_same_v<ValueType, bool>) {
    fill_value = true;
  } else {
    fill_value = ValueType(1);
  }

  ValueType* data_ptr = tensor.mutable_data_ptr<ValueType>();
  std::fill(data_ptr, data_ptr + tensor.numel(), fill_value);
}

Error prepare_input_tensors(Method& method, MemoryAllocator& allocator) {
  MethodMeta method_meta = method.method_meta();
  size_t num_inputs = method_meta.num_inputs();

  EValue* input_evalues = allocator.allocateList<EValue>(num_inputs);
  ET_CHECK_OR_RETURN_ERROR(
      input_evalues != nullptr,
      MemoryAllocationFailed,
      "Could not allocate memory for input evalues.");

  Error err = method.get_inputs(input_evalues, num_inputs);
  ET_CHECK_OK_OR_RETURN_ERROR(err);

  for (size_t i = 0; i < num_inputs; i++) {
    auto tag = method_meta.input_tag(i);
    ET_CHECK_OK_OR_RETURN_ERROR(tag.error());

    if (tag.get() != Tag::Tensor) {
      ET_LOG(
          Debug,
          "Skipping non-tensor input %lu",
          static_cast<unsigned long>(i));
      continue;
    }

    // Fill tensors with default values (1) when no input data is provided
    if (input_evalues[i].isTensor()) {
      Tensor& tensor = input_evalues[i].toTensor();
      switch (tensor.scalar_type()) {
#define HANDLE_SCALAR_TYPE(cpp_type, scalar_name)     \
  case ScalarType::scalar_name:                       \
    fill_tensor_with_default_value<cpp_type>(tensor); \
    break;
        ET_FORALL_SCALAR_TYPES(HANDLE_SCALAR_TYPE)
#undef HANDLE_SCALAR_TYPE
        default:
          ET_LOG(
              Error, "Unhandled ScalarType %s", toString(tensor.scalar_type()));
          err = Error::InvalidArgument;
          break;
      }
    } else {
      printf("Input[%lu]: Not Tensor\n", static_cast<unsigned long>(i));
    }
  }

  return err;
}

#if defined(FILESYSTEM_LOAD)
/**
 * Load a binary file from the filesystem.
 * Supports SPIFFS, LittleFS, or SD card mounted filesystems.
 */
std::pair<char*, size_t> load_file_from_fs(
    const char* filepath,
    MemoryAllocator& allocator) {
  FILE* fp = fopen(filepath, "rb");
  if (!fp) {
    ET_LOG(Fatal, "Could not open file %s (errno: %d)", filepath, errno);
    return std::make_pair(nullptr, 0);
  }

  if (fseek(fp, 0, SEEK_END) != 0) {
    ET_LOG(
        Fatal, "Failed to seek to end of file %s (errno: %d)", filepath, errno);
    fclose(fp);
    return std::make_pair(nullptr, 0);
  }
  auto file_size = ftell(fp);
  if (file_size <= 0) {
    ET_LOG(
        Fatal,
        "Failed to determine valid size for file %s (size: %ld, errno: %d)",
        filepath,
        static_cast<long>(file_size),
        errno);
    fclose(fp);
    return std::make_pair(nullptr, 0);
  }

  if (fseek(fp, 0, SEEK_SET) != 0) {
    ET_LOG(
        Fatal,
        "Failed to seek to beginning of file %s (errno: %d)",
        filepath,
        errno);
    fclose(fp);
    return std::make_pair(nullptr, 0);
  }
  const size_t size = static_cast<size_t>(file_size);
  char* buffer = static_cast<char*>(allocator.allocate(size));
  if (buffer == nullptr) {
    ET_LOG(
        Fatal,
        "Failed to allocate %lu bytes for file %s",
        static_cast<unsigned long>(size),
        filepath);
    fclose(fp);
    return std::make_pair(nullptr, 0);
  }

  auto read_size = fread(buffer, 1, size, fp);
  if (read_size != size) {
    ET_LOG(
        Fatal,
        "Partial read of %s: got %lu of %lu bytes",
        filepath,
        static_cast<unsigned long>(read_size),
        static_cast<unsigned long>(size));
    fclose(fp);
    return std::make_pair(nullptr, 0);
  }
  fclose(fp);
  return std::make_pair(buffer, read_size);
}

#if defined(ESP_PLATFORM)
/**
 * Initialize SPIFFS filesystem for loading model files.
 */
bool init_spiffs(const char* base_path, const char* partition_label) {
  esp_vfs_spiffs_conf_t conf = {
      .base_path = base_path,
      .partition_label = partition_label,
      .max_files = 5,
      .format_if_mount_failed = false,
  };

  esp_err_t ret = esp_vfs_spiffs_register(&conf);
  if (ret != ESP_OK) {
    if (ret == ESP_FAIL) {
      ET_LOG(Error, "Failed to mount SPIFFS filesystem");
    } else if (ret == ESP_ERR_NOT_FOUND) {
      ET_LOG(Error, "SPIFFS partition not found");
    } else {
      ET_LOG(Error, "SPIFFS init failed: %s", esp_err_to_name(ret));
    }
    return false;
  }

  size_t total = 0, used = 0;
  ret = esp_spiffs_info(partition_label, &total, &used);
  if (ret == ESP_OK) {
    ET_LOG(
        Info,
        "SPIFFS: total=%lu, used=%lu",
        static_cast<unsigned long>(total),
        static_cast<unsigned long>(used));
  }
  return true;
}
#endif // ESP_PLATFORM
#endif // FILESYSTEM_LOAD

/// Holds all state needed for setup and run phases
struct RunnerContext {
  RunnerContext() = default;
  RunnerContext(const RunnerContext& ctx) = delete;
  RunnerContext& operator=(const RunnerContext& ctx) = delete;

  const char* method_name = nullptr;
  size_t planned_buffer_memsize = 0;
  size_t method_loaded_memsize = 0;
  size_t executor_membase = 0;
  size_t program_data_len = 0;
  size_t input_memsize = 0;
  size_t pte_size = 0;
  bool bundle_io = false;
  Box<BufferDataLoader> loader;
  Box<Program> program;
  Box<EspMemoryAllocator> method_allocator;
  Box<EspMemoryAllocator> temp_allocator;
  std::vector<Span<uint8_t>> planned_spans;
  Box<HierarchicalAllocator> planned_memory;
  Box<MemoryManager> memory_manager;
  Box<Result<Method>> method;
#if defined(ET_EVENT_TRACER_ENABLED)
  Box<ETDumpGen> etdump_gen;
#if defined(ET_DUMP_INTERMEDIATE_OUTPUTS) || defined(ET_DUMP_OUTPUTS)
  void* debug_buffer;
#endif
#endif
};

void runner_init(RunnerContext& ctx, size_t pte_size) {
  const void* program_data = model_pte;
  ctx.program_data_len = pte_size;
  ctx.pte_size = pte_size;

#if defined(ET_BUNDLE_IO)
  ctx.bundle_io = executorch::bundled_program::is_bundled_program(
      reinterpret_cast<void*>(model_pte), ctx.pte_size);
  if (ctx.bundle_io) {
    Error status = executorch::bundled_program::get_program_data(
        reinterpret_cast<void*>(model_pte),
        ctx.pte_size,
        &program_data,
        &ctx.program_data_len);
    ET_CHECK_MSG(
        status == Error::Ok,
        "get_program_data() from bundle PTE failed: 0x%x",
        (unsigned int)status);
  }
#endif

  ctx.loader.reset(program_data, ctx.program_data_len);
  auto& loader = ctx.loader.value();
  ET_LOG(
      Info,
      "PTE Model data loaded. Size: %lu bytes.",
      static_cast<unsigned long>(ctx.program_data_len));

  // Parse the program file
  Result<Program> program_result = Program::load(&loader);
  ET_CHECK_MSG(
      program_result.ok(),
      "Program loading failed @ %p: 0x%" PRIx32,
      program_data,
      static_cast<uint32_t>(program_result.error()));
  ctx.program.reset(std::move(program_result.get()));
  Program& program = ctx.program.value();

  ET_LOG(
      Info,
      "Model buffer loaded, has %lu methods",
      static_cast<unsigned long>(program.num_methods()));

  {
    const auto method_name_result = program.get_method_name(0);
    ET_CHECK_MSG(method_name_result.ok(), "Program has no methods");
    ctx.method_name = *method_name_result;
  }
  ET_LOG(Info, "Running method %s", ctx.method_name);

  Result<MethodMeta> method_meta = program.method_meta(ctx.method_name);
  ET_CHECK_MSG(
      method_meta.ok(),
      "Failed to get method_meta for %s: 0x%x",
      ctx.method_name,
      (unsigned int)method_meta.error());

  ET_LOG(
      Info,
      "Setup Method allocator pool. Size: %lu bytes.",
      static_cast<unsigned long>(method_allocation_pool_size));

  ctx.method_allocator.reset(
      method_allocation_pool_size, method_allocation_pool);

  ctx.planned_spans.clear();
  size_t num_memory_planned_buffers = method_meta->num_memory_planned_buffers();
  ctx.planned_spans.reserve(num_memory_planned_buffers);
  size_t planned_buffer_membase = ctx.method_allocator->used_size();

  for (size_t id = 0; id < num_memory_planned_buffers; ++id) {
    size_t buffer_size =
        static_cast<size_t>(method_meta->memory_planned_buffer_size(id).get());
    ET_LOG(
        Info,
        "Setting up planned buffer %lu, size %lu.",
        static_cast<unsigned long>(id),
        static_cast<unsigned long>(buffer_size));

    uint8_t* buffer = reinterpret_cast<uint8_t*>(
        ctx.method_allocator->allocate(buffer_size, 16UL));
    ET_CHECK_MSG(
        buffer != nullptr,
        "Could not allocate memory for memory planned buffer size %lu",
        static_cast<unsigned long>(buffer_size));
    ctx.planned_spans.push_back({buffer, buffer_size});
  }

  ctx.planned_buffer_memsize =
      ctx.method_allocator->used_size() - planned_buffer_membase;

  Span<Span<uint8_t>> planned_memory_span;
  if (!ctx.planned_spans.empty()) {
    planned_memory_span =
        Span<Span<uint8_t>>(ctx.planned_spans.data(), ctx.planned_spans.size());
  }
  ctx.planned_memory.reset(planned_memory_span);

  ctx.temp_allocator.reset(temp_allocation_pool_size, temp_allocation_pool);

  ctx.memory_manager.reset(
      &ctx.method_allocator.value(),
      &ctx.planned_memory.value(),
      &ctx.temp_allocator.value());

  size_t method_loaded_membase = ctx.method_allocator->used_size();

  executorch::runtime::EventTracer* event_tracer_ptr = nullptr;

#if defined(ET_EVENT_TRACER_ENABLED)
  ET_LOG(Info, "Setting up ETDump");
  ctx.etdump_gen.reset();
  event_tracer_ptr = &ctx.etdump_gen.value();

#if defined(ET_DUMP_INTERMEDIATE_OUTPUTS) || defined(ET_DUMP_OUTPUTS)
  ctx.debug_buffer = ctx.method_allocator->allocate(ET_DEBUG_BUFFER_SIZE, 16);
  if (ctx.debug_buffer != nullptr) {
    Span<uint8_t> debug_buffer_span(
        (uint8_t*)ctx.debug_buffer, ET_DEBUG_BUFFER_SIZE);

    Result<bool> result =
        ctx.etdump_gen.value().set_debug_buffer(debug_buffer_span);

    if (result.ok()) {
#if defined(ET_DUMP_INTERMEDIATE_OUTPUTS)
      ET_LOG(
          Info,
          "ETDump: Allocated intermediate output buffer size: %d at 0x%p",
          ET_DEBUG_BUFFER_SIZE,
          ctx.debug_buffer);
      ctx.etdump_gen.value().set_event_tracer_debug_level(
          EventTracerDebugLogLevel::kIntermediateOutputs);
#else
      ET_LOG(
          Info,
          "ETDump: Allocated output buffer size: %d at 0x%p",
          ET_DEBUG_BUFFER_SIZE,
          ctx.debug_buffer);
      ctx.etdump_gen.value().set_event_tracer_debug_level(
          EventTracerDebugLogLevel::kProgramOutputs);
#endif
    } else {
      ctx.debug_buffer = nullptr;
      ET_LOG(
          Error,
          "ETDump: Could not set_debug_buffer() error:0x%" PRIx32,
          result.error());
    }
  } else {
    ET_LOG(
        Error,
        "ETDump: Could not allocate output buffer size %lu",
        static_cast<unsigned long>(ET_DEBUG_BUFFER_SIZE));
  }
#endif // ET_DUMP_INTERMEDIATE_OUTPUTS || ET_DUMP_OUTPUTS
#endif // ET_EVENT_TRACER_ENABLED

  ctx.method.reset(program.load_method(
      ctx.method_name, &ctx.memory_manager.value(), event_tracer_ptr));

  if (!ctx.method->ok()) {
    ET_LOG(
        Info,
        "Loading of method %s failed with status 0x%" PRIx32,
        ctx.method_name,
        static_cast<unsigned long>(ctx.method->error()));
  }
  ctx.method_loaded_memsize =
      ctx.method_allocator->used_size() - method_loaded_membase;
  ET_LOG(Info, "Method '%s' loaded.", ctx.method_name);

  ET_LOG(Info, "Preparing inputs...");
  size_t input_membase = ctx.method_allocator->used_size();

#if defined(ET_BUNDLE_IO)
  if (ctx.bundle_io) {
    ET_LOG(Info, "Input testset[%d] from bundled bpte", testset_idx);
    Error status = executorch::bundled_program::load_bundled_input(
        *ctx.method.value(), model_pte, testset_idx);
    ET_CHECK_MSG(
        status == Error::Ok,
        "load_bundled_input failed with status 0x%" PRIx32,
        status);
  } else
#endif
  {
    Error status = ::prepare_input_tensors(
        *ctx.method.value(), ctx.method_allocator.value());
    ET_CHECK_MSG(
        status == Error::Ok,
        "Failed to prepare inputs 0x%" PRIx32,
        static_cast<uint32_t>(status));
  }

#if defined(ET_LOG_DUMP_INPUT)
  {
    std::vector<EValue> inputs(ctx.method.value()->inputs_size());
    ET_LOG(Info, "%lu inputs: ", static_cast<unsigned long>(inputs.size()));
    Error status = ctx.method.value()->get_inputs(inputs.data(), inputs.size());
    ET_CHECK(status == Error::Ok);

    for (int i = 0; i < inputs.size(); ++i) {
      if (inputs[i].isTensor()) {
        Tensor tensor = inputs[i].toTensor();
        for (int j = 0; j < tensor.numel(); ++j) {
          if (tensor.scalar_type() == ScalarType::Int) {
            printf(
                "Input[%d][%d]: (int) %d\n",
                i,
                j,
                tensor.const_data_ptr<int>()[j]);
          } else if (tensor.scalar_type() == ScalarType::Float) {
            printf(
                "Input[%d][%d]: (float) %f\n",
                i,
                j,
                tensor.const_data_ptr<float>()[j]);
          } else if (tensor.scalar_type() == ScalarType::Char) {
            printf(
                "Input[%d][%d]: (char) %d\n",
                i,
                j,
                tensor.const_data_ptr<int8_t>()[j]);
          } else if (tensor.scalar_type() == ScalarType::Bool) {
            printf(
                "Input[%d][%d]: (bool) %s (0x%x)\n",
                i,
                j,
                tensor.const_data_ptr<int8_t>()[j] ? "true" : "false",
                tensor.const_data_ptr<int8_t>()[j]);
          }
        }
      } else {
        printf("Input[%d]: Not Tensor\n", i);
      }
    }
  }
#endif

  ctx.input_memsize = ctx.method_allocator->used_size() - input_membase;
  ctx.executor_membase = ctx.method_allocator->used_size();

  ET_LOG(Info, "Input prepared.");
}

void log_mem_status(RunnerContext& ctx) {
  size_t executor_memsize =
      ctx.method_allocator->used_size() - ctx.executor_membase;

  ET_LOG(
      Info,
      "model_pte_program_size:     %lu bytes.",
      static_cast<unsigned long>(ctx.program_data_len));
  ET_LOG(
      Info,
      "model_pte_loaded_size:      %lu bytes.",
      static_cast<unsigned long>(ctx.pte_size));

  if (ctx.method_allocator->size() != 0) {
    size_t method_allocator_used = ctx.method_allocator->used_size();
    ET_LOG(
        Info,
        "method_allocator_used:     %lu / %lu  free: %lu ( used: %lu %% ) ",
        static_cast<unsigned long>(method_allocator_used),
        static_cast<unsigned long>(ctx.method_allocator->size()),
        static_cast<unsigned long>(ctx.method_allocator->free_size()),
        static_cast<unsigned long>(
            100 * method_allocator_used / ctx.method_allocator->size()));
    ET_LOG(
        Info,
        "method_allocator_planned:  %lu bytes",
        static_cast<unsigned long>(ctx.planned_buffer_memsize));
    ET_LOG(
        Info,
        "method_allocator_loaded:   %lu bytes",
        static_cast<unsigned long>(ctx.method_loaded_memsize));
    ET_LOG(
        Info,
        "method_allocator_input:    %lu bytes",
        static_cast<unsigned long>(ctx.input_memsize));
    ET_LOG(
        Info,
        "method_allocator_executor: %lu bytes",
        static_cast<unsigned long>(executor_memsize));
  }
  if (ctx.temp_allocator->size() > 0) {
    ET_LOG(
        Info,
        "temp_allocator:            %lu",
        static_cast<unsigned long>(ctx.temp_allocator->size()));
  }

#if defined(ESP_PLATFORM)
  ET_LOG(
      Info,
      "ESP free heap:             %lu bytes",
      static_cast<unsigned long>(esp_get_free_heap_size()));
  ET_LOG(
      Info,
      "ESP min free heap ever:    %lu bytes",
      static_cast<unsigned long>(esp_get_minimum_free_heap_size()));
#if defined(CONFIG_SPIRAM)
  ET_LOG(
      Info,
      "ESP free PSRAM:            %lu bytes",
      static_cast<unsigned long>(heap_caps_get_free_size(MALLOC_CAP_SPIRAM)));
#endif
#endif

#if defined(ET_EVENT_TRACER_ENABLED)
#if defined(ET_DUMP_INTERMEDIATE_OUTPUTS) || defined(ET_DUMP_OUTPUTS)
  if (ctx.debug_buffer != nullptr) {
    size_t outputdump_len = ctx.etdump_gen->get_data_sink()->get_used_bytes();
    ET_LOG(
        Info,
        "ETDump_outputs_buffer:     %lu / %lu free: %lu ( used: %lu %% ) ",
        static_cast<unsigned long>(outputdump_len),
        static_cast<unsigned long>(ET_DEBUG_BUFFER_SIZE),
        static_cast<unsigned long>(ET_DEBUG_BUFFER_SIZE - outputdump_len),
        static_cast<unsigned long>(
            100 * outputdump_len / ET_DEBUG_BUFFER_SIZE));
  }
#endif
#endif
}

void print_outputs(RunnerContext& ctx) {
  std::vector<EValue> outputs(ctx.method.value()->outputs_size());
  ET_LOG(Info, "%lu outputs: ", static_cast<unsigned long>(outputs.size()));
  Error status =
      ctx.method.value()->get_outputs(outputs.data(), outputs.size());
  ET_CHECK(status == Error::Ok);

  for (int i = 0; i < outputs.size(); ++i) {
    if (outputs[i].isTensor()) {
      Tensor tensor = outputs[i].toTensor();
#if defined(ET_LOG_DUMP_OUTPUT)
      for (int j = 0; j < tensor.numel(); ++j) {
        if (tensor.scalar_type() == ScalarType::Int) {
          printf(
              "Output[%d][%d]: (int) %d\n",
              i,
              j,
              tensor.const_data_ptr<int>()[j]);
        } else if (tensor.scalar_type() == ScalarType::Float) {
          printf(
              "Output[%d][%d]: (float) %f\n",
              i,
              j,
              tensor.const_data_ptr<float>()[j]);
        } else if (tensor.scalar_type() == ScalarType::Char) {
          printf(
              "Output[%d][%d]: (char) %d\n",
              i,
              j,
              tensor.const_data_ptr<int8_t>()[j]);
        } else if (tensor.scalar_type() == ScalarType::Bool) {
          printf(
              "Output[%d][%d]: (bool) %s (0x%x)\n",
              i,
              j,
              tensor.const_data_ptr<int8_t>()[j] ? "true " : "false",
              tensor.const_data_ptr<int8_t>()[j]);
        }
      }
#endif
    } else {
      printf("Output[%d]: Not Tensor\n", i);
    }
  }
}

void write_etdump(RunnerContext& ctx) {
#if defined(ET_EVENT_TRACER_ENABLED)
  ETDumpResult result = ctx.etdump_gen->get_etdump_data();
  if (result.buf != nullptr && result.size > 0) {
    ET_LOG(
        Info,
        "ETDump data generated: %lu bytes",
        static_cast<unsigned long>(result.size));

    // On ESP32, we could write to SPIFFS/SD or dump via serial.
    // For now, log the size. In a production setup, you would
    // write this to a filesystem or transmit over a network interface.
#if defined(FILESYSTEM_LOAD) && defined(ESP_PLATFORM)
    const char* etdump_filename = "/spiffs/etdump.bin";
    ET_LOG(Info, "Writing etdump to file: %s", etdump_filename);
    FILE* f = fopen(etdump_filename, "wb");
    if (f) {
      size_t bytes_written = fwrite((uint8_t*)result.buf, 1, result.size, f);
      if (bytes_written != result.size) {
        ET_LOG(
            Error,
            "Failed to write complete ETDump data to %s (wrote %lu of %lu bytes)",
            etdump_filename,
            static_cast<unsigned long>(bytes_written),
            static_cast<unsigned long>(result.size));
      }
      fclose(f);
    } else {
      ET_LOG(Error, "Could not open %s for writing", etdump_filename);
    }
#endif
  }
#endif
}

bool verify_result(RunnerContext& ctx, const void* model_pte) {
  bool model_ok = false;
#if defined(ET_BUNDLE_IO)
  if (ctx.bundle_io) {
    ErrorStats stats = compute_method_output_error_stats(
        *ctx.method.value(), model_pte, testset_idx);
    if (stats.status == Error::Ok) {
      ET_LOG(Info, "=== Error stats for testset %d ===", testset_idx);
      ET_LOG(Info, " mean_absolute_error: %f", stats.mean_abs_error);
      ET_LOG(Info, " max_absolute_error:  %f", stats.max_abs_error);
      ET_LOG(Info, " mean_relative_error: %f", stats.mean_relative_error);
      ET_LOG(Info, " max_relative_error:  %f", stats.max_relative_error);
    } else {
      ET_LOG(
          Info,
          "=== Error calculating stats for testset %d ERROR:%d ===",
          testset_idx,
          stats.status);
    }

    Error status = verify_method_outputs(
        *ctx.method.value(), model_pte, testset_idx, et_rtol, et_atol);
    if (status == Error::Ok) {
      ET_LOG(Info, "Model output match expected BundleIO bpte ref data.");
      ET_LOG(Info, "TEST: BundleIO index[%d] Test_result: PASS", testset_idx);
      model_ok = true;
    } else {
      ET_LOG(
          Error,
          "Model output don't match expected BundleIO bpte ref data. rtol=%f atol=%f",
          et_rtol,
          et_atol);
      ET_LOG(Error, "TEST: BundleIO index[%d] Test_result: FAIL", testset_idx);
      model_ok = false;
    }
  } else {
    model_ok = true;
  }
#else
  (void)ctx;
  (void)model_pte;
  model_ok = true;
#endif
  return model_ok;
}

bool run_model(RunnerContext& ctx, const void* model_pte) {
  Error status = Error::Ok;
  if (num_inferences <= 0) {
    ET_LOG(
        Info,
        "num_inferences (%d) <= 0; skipping model execution.",
        num_inferences);
    // Nothing to run; treat as a no-op run.
    return true;
  }
  ET_LOG(Info, "Starting running %d inferences...", num_inferences);
  int successful_inferences = 0;
  StartMeasurements();
  for (int n = 0; n < num_inferences; n++) {
    ET_LOG(Debug, "Running inference number %d", n);
    status = ctx.method.value()->execute();
    if (status != Error::Ok) {
      break;
    }
    // Reset the temporary allocator between inferences
    ctx.temp_allocator.reset(temp_allocation_pool_size, temp_allocation_pool);
    successful_inferences++;
  }
  if (successful_inferences > 0) {
    StopMeasurements(successful_inferences);
  }

  ET_CHECK_MSG(
      status == Error::Ok,
      "Execution of method %s failed with status 0x%" PRIx32,
      ctx.method_name,
      static_cast<unsigned long>(status));

  ET_LOG(Info, "%d inferences finished", successful_inferences);
  print_outputs(ctx);
  bool model_ok = verify_result(ctx, model_pte);
  ET_LOG(Info, "Model run: %d", model_ok);

  return model_ok;
}

} // namespace

// =====================================================================
// Global runner state -- shared by the public et_runner_* API and by
// executor_runner_main() for its multi-inference demo loop.
// =====================================================================

static RunnerContext g_runner_ctx;
static bool g_runner_initialized = false;

// Maximum number of input/output tensors handled in the public API.
static const size_t kMaxInputOutputs = 16;

// =====================================================================
// Public API
// =====================================================================

bool et_runner_init(void) {
  executorch::runtime::runtime_init();

  size_t pte_size;

#if defined(FILESYSTEM_LOAD)
#if defined(ESP_PLATFORM)
  if (!init_spiffs("/spiffs", "storage")) {
    ET_LOG(Fatal, "Failed to initialize SPIFFS. Cannot load model.");
    return false;
  }
#endif
  EspMemoryAllocator file_allocator(
      method_allocation_pool_size, method_allocation_pool);
  auto [buffer, buffer_size] =
      load_file_from_fs("/spiffs/model.pte", file_allocator);
  if (buffer == nullptr) {
    ET_LOG(Fatal, "Failed to load model from filesystem.");
    return false;
  }
  model_pte = buffer;
  model_pte_size = buffer_size;
  pte_size = buffer_size;
#else
  pte_size = sizeof(model_pte);
#endif

  runner_init(g_runner_ctx, pte_size);
  g_runner_initialized = g_runner_ctx.method->ok();
  return g_runner_initialized;
}

bool et_runner_set_input(size_t input_idx, const void* data, size_t num_bytes) {
  if (!g_runner_initialized) {
    ET_LOG(Error, "Runner not initialized. Call et_runner_init() first.");
    return false;
  }

  Method& method = *g_runner_ctx.method.value();
  const size_t num_inputs = method.inputs_size();

  if (input_idx >= num_inputs) {
    ET_LOG(
        Error,
        "Input index %lu out of range (num_inputs=%lu).",
        static_cast<unsigned long>(input_idx),
        static_cast<unsigned long>(num_inputs));
    return false;
  }
  if (num_inputs > kMaxInputOutputs) {
    ET_LOG(
        Error,
        "Model has too many inputs (%lu > %lu).",
        static_cast<unsigned long>(num_inputs),
        static_cast<unsigned long>(kMaxInputOutputs));
    return false;
  }

  // get_inputs() returns shallow copies whose data pointers alias the
  // method's internal tensor storage, allowing direct writes.
  EValue input_evalues[kMaxInputOutputs];
  Error status = method.get_inputs(input_evalues, num_inputs);
  if (status != Error::Ok) {
    ET_LOG(
        Error,
        "get_inputs() failed with status 0x%" PRIx32,
        static_cast<uint32_t>(status));
    return false;
  }

  if (!input_evalues[input_idx].isTensor()) {
    ET_LOG(
        Error,
        "Input %lu is not a Tensor.",
        static_cast<unsigned long>(input_idx));
    return false;
  }

  Tensor& tensor = input_evalues[input_idx].toTensor();
  const size_t tensor_bytes = tensor.nbytes();
  if (num_bytes > tensor_bytes) {
    ET_LOG(
        Error,
        "Input %lu: provided %lu bytes exceeds tensor capacity %lu bytes.",
        static_cast<unsigned long>(input_idx),
        static_cast<unsigned long>(num_bytes),
        static_cast<unsigned long>(tensor_bytes));
    return false;
  }
  // Treat zero-length input as a no-op.
  if (num_bytes == 0) {
    return true;
  }
  // For non-zero length, the input data pointer must be non-null.
  if (data == nullptr) {
    ET_LOG(
        Error,
        "Input %lu: data pointer is null for non-zero num_bytes (%lu).",
        static_cast<unsigned long>(input_idx),
        static_cast<unsigned long>(num_bytes));
    return false;
  }

  memcpy(tensor.mutable_data_ptr(), data, num_bytes);
  return true;
}

bool et_runner_execute(void) {
  if (!g_runner_initialized) {
    ET_LOG(Error, "Runner not initialized. Call et_runner_init() first.");
    return false;
  }

  Method& method = *g_runner_ctx.method.value();
  Error status = method.execute();
  // Reset the temporary allocator so it is ready for the next inference.
  g_runner_ctx.temp_allocator.reset(
      temp_allocation_pool_size, temp_allocation_pool);
  if (status != Error::Ok) {
    ET_LOG(
        Error,
        "execute() failed with status 0x%" PRIx32,
        static_cast<uint32_t>(status));
    return false;
  }
  return true;
}

bool et_runner_get_output(
    size_t output_idx,
    void* buffer,
    size_t buffer_bytes,
    size_t* out_num_elements) {
  if (!g_runner_initialized) {
    ET_LOG(Error, "Runner not initialized. Call et_runner_init() first.");
    return false;
  }

  Method& method = *g_runner_ctx.method.value();
  const size_t num_outputs = method.outputs_size();

  if (output_idx >= num_outputs) {
    ET_LOG(
        Error,
        "Output index %lu out of range (num_outputs=%lu).",
        static_cast<unsigned long>(output_idx),
        static_cast<unsigned long>(num_outputs));
    return false;
  }
  if (num_outputs > kMaxInputOutputs) {
    ET_LOG(
        Error,
        "Model has too many outputs (%lu > %lu).",
        static_cast<unsigned long>(num_outputs),
        static_cast<unsigned long>(kMaxInputOutputs));
    return false;
  }

  EValue output_evalues[kMaxInputOutputs];
  Error status = method.get_outputs(output_evalues, num_outputs);
  if (status != Error::Ok) {
    ET_LOG(
        Error,
        "get_outputs() failed with status 0x%" PRIx32,
        static_cast<uint32_t>(status));
    return false;
  }

  if (!output_evalues[output_idx].isTensor()) {
    ET_LOG(
        Error,
        "Output %lu is not a Tensor.",
        static_cast<unsigned long>(output_idx));
    return false;
  }

  Tensor tensor = output_evalues[output_idx].toTensor();
  const size_t tensor_bytes = tensor.nbytes();
  if (buffer_bytes < tensor_bytes) {
    ET_LOG(
        Error,
        "Output %lu: buffer too small (%lu bytes < %lu bytes required).",
        static_cast<unsigned long>(output_idx),
        static_cast<unsigned long>(buffer_bytes),
        static_cast<unsigned long>(tensor_bytes));
    return false;
  }

  memcpy(buffer, tensor.const_data_ptr(), tensor_bytes);
  if (out_num_elements != nullptr) {
    *out_num_elements = static_cast<size_t>(tensor.numel());
  }
  return true;
}

size_t et_runner_inputs_size(void) {
  if (!g_runner_initialized) {
    return 0;
  }
  return (*g_runner_ctx.method.value()).inputs_size();
}

size_t et_runner_outputs_size(void) {
  if (!g_runner_initialized) {
    return 0;
  }
  return (*g_runner_ctx.method.value()).outputs_size();
}

/**
 * Main entry point for the ESP32 executor runner.
 *
 * On ESP-IDF, this is called from app_main() (see below).
 * The function can also be compiled for host testing without ESP-IDF.
 */
void executor_runner_main(void) {
  if (!et_runner_init()) {
    return;
  }

  // Log the PTE magic bytes for quick sanity check
  ET_LOG(
      Info,
      "PTE @ %p [----%c%c%c%c]",
      model_pte,
      model_pte[4],
      model_pte[5],
      model_pte[6],
      model_pte[7]);

  bool model_ok = run_model(g_runner_ctx, model_pte);
  ET_LOG(Info, "Model run: %d", model_ok);

  log_mem_status(g_runner_ctx);
  write_etdump(g_runner_ctx);

  ET_CHECK_MSG(model_ok == true, "Problem running model");

  ET_LOG(Info, "Program complete.");
}