## examples/espressif/project/sdkconfig.defaults
```kconfig
# ESP-IDF sdkconfig defaults for ExecuTorch executor runner
#
# These settings are optimized for running ExecuTorch models on ESP32/ESP32-S3.
# Copy this file as sdkconfig.defaults in your project directory.

# ─── CPU Frequency ───
# Run at maximum frequency for best inference performance
CONFIG_ESP_DEFAULT_CPU_FREQ_MHZ_240=y

# ─── PSRAM (if available) ───
# Enable PSRAM for larger model support
CONFIG_SPIRAM=y
#CONFIG_SPIRAM_MODE_QUAD=y
CONFIG_SPIRAM_MODE_OCT=y
CONFIG_SPIRAM_SPEED_80M=y
# Allow malloc to fall back to PSRAM when internal RAM is exhausted
CONFIG_SPIRAM_USE_CAPS_ALLOC=y
# Place BSS in PSRAM (for large static buffers)
CONFIG_SPIRAM_ALLOW_BSS_SEG_EXTERNAL_MEMORY=y

# ─── Memory ───
# Increase main task stack size for ExecuTorch
CONFIG_ESP_MAIN_TASK_STACK_SIZE=32768

# ─── Flash ───
# Use QIO flash mode for faster flash reads (model data)
CONFIG_ESPTOOLPY_FLASHMODE_QIO=y
CONFIG_ESPTOOLPY_FLASHFREQ_80M=y
# Larger flash size for model data
CONFIG_ESPTOOLPY_FLASHSIZE_8MB=y

# ─── Optimization ───
# Optimize for performance
CONFIG_COMPILER_OPTIMIZATION_PERF=y

# ─── FreeRTOS ───
# Increase tick rate for finer timing granularity
CONFIG_FREERTOS_HZ=1000

# ─── Logging ───
# Default log level (can be changed at runtime)
CONFIG_LOG_DEFAULT_LEVEL_INFO=y

# ─── Watchdog ───
# Disable task watchdog for long-running inference
CONFIG_ESP_TASK_WDT_EN=n


CONFIG_PARTITION_TABLE_CUSTOM=y
CONFIG_PARTITION_TABLE_CUSTOM_FILENAME="partitions.csv"
CONFIG_PARTITION_TABLE_FILENAME="partitions.csv"
```

## examples/espressif/project/sdkconfig.defaults.esp32s3
```kconfig
# ESP-IDF sdkconfig defaults for ESP32-S3 target
#
# ESP32-S3 specific optimizations:
# - Octal PSRAM support (up to 32MB)
# - Dual-core Xtensa LX7 at 240MHz
# - Vector extensions for faster computation

# ─── CPU ───
CONFIG_ESP_DEFAULT_CPU_FREQ_MHZ_240=y

# ─── PSRAM (Octal PSRAM for ESP32-S3) ───
CONFIG_SPIRAM=y
#CONFIG_SPIRAM_MODE_QUAD=y
CONFIG_SPIRAM_MODE_OCT=y
CONFIG_SPIRAM_SPEED_80M=y
CONFIG_SPIRAM_USE_CAPS_ALLOC=y
CONFIG_SPIRAM_ALLOW_BSS_SEG_EXTERNAL_MEMORY=y

# ─── Memory ───
CONFIG_ESP_MAIN_TASK_STACK_SIZE=32768

# ─── Flash ───
CONFIG_ESPTOOLPY_FLASHMODE_QIO=y
CONFIG_ESPTOOLPY_FLASHFREQ_80M=y
CONFIG_ESPTOOLPY_FLASHSIZE_8MB=y

# ─── Optimization ───
CONFIG_COMPILER_OPTIMIZATION_PERF=y

# ─── FreeRTOS ───
CONFIG_FREERTOS_HZ=1000

# ─── Watchdog ───
CONFIG_ESP_TASK_WDT_EN=n

# ─── Logging ───
CONFIG_LOG_DEFAULT_LEVEL_INFO=y

CONFIG_PARTITION_TABLE_CUSTOM=y
CONFIG_PARTITION_TABLE_CUSTOM_FILENAME="partitions.csv"
CONFIG_PARTITION_TABLE_FILENAME="partitions.csv"
```

## examples/nordic/simple_rnn/boards/nrf54lm20dk_nrf54lm20b_cpuapp.conf
```kconfig
# Board-specific config for nRF54LM20DK (nRF54LM20B with AXON NPU)

# AXON NPU
CONFIG_NRF_AXON=y
CONFIG_NRF_AXON_INTERLAYER_BUFFER_SIZE=256
CONFIG_NRF_AXON_PSUM_BUFFER_SIZE=0

# RRAM must stay in standby mode for AXON
CONFIG_MPSL_FORCE_RRAM_ON_ALL_THE_TIME=y
```

## zephyr/Kconfig
```kconfig
# Copyright (c) 2025 Petri Oksanen
# Copyright (c) Meta Platforms, Inc. and affiliates.
# All rights reserved.
# Copyright 2025-2026 Arm Limited and/or its affiliates.
#
# SPDX-License-Identifier: Apache-2.0

config ZEPHYR_EXECUTORCH_MODULE
	bool

config EXECUTORCH
	bool "ExecuTorch Support"
	select REQUIRES_FULL_LIBCPP
	help
	  This option enables the ExecuTorch library.

if EXECUTORCH

config EXECUTORCH_ENABLE_LOGGING
	bool "Enable ExecuTorch logging"
	default y
	help
	  Enable logging within the ExecuTorch runtime.

config EXECUTORCH_ENABLE_EVENT_TRACER
	bool "Enable ExecuTorch event tracer"
	default n
	help
	  Enable the event tracer for performance profiling.

config EXECUTORCH_ENABLE_PROGRAM_VERIFICATION
	bool "Enable ExecuTorch program verification"
	default n
	help
	  Enable verification of the ExecuTorch program flatbuffer.

config EXECUTORCH_OPTIMIZE_FOR_SIZE
	bool "Optimize ExecuTorch for size"
	default y
	help
	  Optimize the ExecuTorch library for size (-Os).

config EXECUTORCH_BUILD_PORTABLE_OPS
	bool "Build ExecuTorch portable operators library"
	default y
	help
	  Build the default portable operators library that includes all
	  available operators. When disabled, you should use selective
	  operator building to include only needed operators, but the
	  underlying kernel implementations will still be available.

config EXECUTORCH_EXPORT_PYTHON_SCRIPT
	string "Python exporter script"
	default ""
	help
	  Optional Python script run during CMake configure to generate the
	  model file embedded by the sample or application.

config EXECUTORCH_EXPORT_PYTHON_ARGS
	string "Python exporter arguments"
	default ""
	help
	  Optional extra command-line arguments appended when invoking
	  CONFIG_EXECUTORCH_EXPORT_PYTHON_SCRIPT. Use this for exporter-
	  specific lowering flags such as backend or target selection.

config EXECUTORCH_EXPORT_PYTHON_DEPENDENCIES
	string "Python exporter dependency files"
	default ""
	help
	  Optional space-separated list of files that should trigger CMake
	  reconfigure when changed. Use this for local Python helper modules or
	  other side files imported by CONFIG_EXECUTORCH_EXPORT_PYTHON_SCRIPT.

config EXECUTORCH_EXPORT_PYTHON_GENERATED_OUTPUT
	string "Python exporter generated output path"
	default ""
	help
	  Optional output path that Zephyr expects the exporter script to
	  write. Relative paths are resolved from the sample build directory.

endif # EXECUTORCH
```
