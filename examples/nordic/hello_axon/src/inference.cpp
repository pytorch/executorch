/*
 * Copyright (c) 2026 iote.ai
 * All rights reserved.
 *
 * This source code is licensed under the BSD-style license found in the
 * LICENSE file in the root directory of this source tree.
 *
 * ExecuTorch inference runner for hello_axon.
 *
 * Loads an embedded .pte model, runs inference, prints output.
 * If the model has AXON-delegated subgraphs, those run on the NPU
 * automatically via the AxonBackend delegate.
 */

#include <cstdint>
#include <cstring>

#include <zephyr/kernel.h>
#include <zephyr/timing/timing.h>

#include <executorch/runtime/executor/program.h>
#include <executorch/runtime/executor/method.h>
#include <executorch/runtime/executor/memory_manager.h>
#include <executorch/runtime/core/exec_aten/exec_aten.h>
#include <executorch/extension/data_loader/buffer_data_loader.h>
#include <executorch/runtime/platform/log.h>

/* The .pte model embedded as a C array.
 * Generated by export_model.py → src/model_pte.h
 */
#include "model_pte.h"

namespace et = executorch::runtime;
using et::Error;
using et::EValue;
using et::HierarchicalAllocator;
using et::MemoryAllocator;
using et::MemoryManager;
using et::Method;
using et::Program;
using et::Result;
using et::Span;
using executorch::extension::BufferDataLoader;
using exec_aten::ScalarType;
using exec_aten::Tensor;
using exec_aten::TensorImpl;

/* Static memory pools */
static uint8_t method_allocator_pool[16 * 1024];
static uint8_t planned_memory_pool[16 * 1024];
static uint8_t temp_allocator_pool[4 * 1024];

extern "C" int run_inference(void)
{
    if (model_pte_len == 0) {
        ET_LOG(Error, "No model embedded. Run: ./setup_export_env.sh && ./run_export.sh");
        return -1;
    }

    ET_LOG(Info, "Loading model (%u bytes)...", model_pte_len);

    BufferDataLoader loader(model_pte, model_pte_len);
    Result<Program> program = Program::load(&loader);
    if (!program.ok()) {
        ET_LOG(Error, "Program::load failed: 0x%x",
               static_cast<uint32_t>(program.error()));
        return -1;
    }
    ET_LOG(Info, "Program loaded, %zu method(s)", program->num_methods());

    const char *method_name = nullptr;
    {
        auto name_result = program->get_method_name(0);
        if (!name_result.ok()) {
            ET_LOG(Error, "No methods in program");
            return -2;
        }
        method_name = *name_result;
    }
    ET_LOG(Info, "Method: %s", method_name);

    /* Memory management */
    MemoryAllocator method_allocator(
        sizeof(method_allocator_pool), method_allocator_pool);
    MemoryAllocator temp_allocator(
        sizeof(temp_allocator_pool), temp_allocator_pool);

    auto method_meta = program->method_meta(method_name);
    if (!method_meta.ok()) {
        ET_LOG(Error, "Failed to get method meta");
        return -3;
    }

    Span<uint8_t> planned_span(planned_memory_pool,
                               sizeof(planned_memory_pool));
    HierarchicalAllocator planned_allocator({&planned_span, 1});
    MemoryManager memory_manager(
        &method_allocator, &planned_allocator, &temp_allocator);

    Result<Method> method = program->load_method(
        method_name, &memory_manager);
    if (!method.ok()) {
        ET_LOG(Error, "load_method failed: 0x%x",
               static_cast<uint32_t>(method.error()));
        return -4;
    }
    ET_LOG(Info, "Method loaded");

    /* Prepare input: single float value */
    float input_data[1] = {1.57f};  /* pi/2 — sin should be ~1.0 */
    Tensor::SizesType input_sizes[] = {1, 1};
    Tensor::DimOrderType input_dim_order[] = {0, 1};
    TensorImpl input_impl(
        ScalarType::Float, 2, input_sizes, input_data, input_dim_order);
    Tensor input_tensor(&input_impl);

    Error err = method->set_input(input_tensor, 0);
    if (err != Error::Ok) {
        ET_LOG(Error, "set_input failed: 0x%x", static_cast<uint32_t>(err));
        return -5;
    }

    /* Run inference.
     * Use timing.h API for true CPU cycles — k_cycle_get_32() on this
     * board ticks at 1 MHz (system clock), not 128 MHz (DWT). */
    timing_init();
    timing_start();

    ET_LOG(Info, "Running inference (x=1.57, expected sin~1.0)...");

    timing_t t_start = timing_counter_get();
    err = method->execute();
    timing_t t_end = timing_counter_get();

    if (err != Error::Ok) {
        ET_LOG(Error, "execute failed: 0x%x", static_cast<uint32_t>(err));
        return -6;
    }

    uint64_t cycles = timing_cycles_get(&t_start, &t_end);
    uint64_t ns = timing_cycles_to_ns(cycles);
    ET_LOG(Info, "Inference: %llu cycles (%llu us @ 128 MHz)",
           (unsigned long long)cycles, (unsigned long long)(ns / 1000));

    /* Read output */
    const EValue &output = method->get_output(0);
    if (output.isTensor()) {
        const auto &out_tensor = output.toTensor();
        if (out_tensor.scalar_type() == ScalarType::Float) {
            const float *data = out_tensor.const_data_ptr<float>();
            for (int i = 0; i < out_tensor.numel() && i < 10; i++) {
                ET_LOG(Info, "  output[%d] = %f", i,
                       static_cast<double>(data[i]));
            }
        }
    }

    ET_LOG(Info, "Done.");
    return 0;
}
