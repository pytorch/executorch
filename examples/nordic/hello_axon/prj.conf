## CMakeLists.txt
```
# Copyright (c) 2026 iote.ai
# All rights reserved.
#
# This source code is licensed under the BSD-style license found in the
# LICENSE file in the root directory of this source tree.
#
# Hello AXON — minimal ExecuTorch + AXON NPU inference.
#
# Build:
#   source nrf-connect-sdk-env.sh
#   west build -b nrf54lm20dk/nrf54lm20b/cpuapp examples/nordic/hello_axon \
#     --no-sysbuild -- \
#     -DZEPHYR_EXTRA_MODULES="<executorch_path>;<sdk_edge_ai_path>"

cmake_minimum_required(VERSION 3.24)

# Skip install rules — avoids ExecuTorch export dependency issues with Zephyr
set(CMAKE_SKIP_INSTALL_RULES ON CACHE BOOL "" FORCE)

find_package(Zephyr REQUIRED HINTS $ENV{ZEPHYR_BASE})
project(hello_axon)

# Source files: main.c (pure C entry) + inference.cpp (C++ ExecuTorch runner)
target_sources(app PRIVATE
    src/main.c
    src/inference.cpp
)

# AXON delegate (from our ExecuTorch fork's backends/nordic/runtime/)
if(CONFIG_NRF_AXON)
    if(DEFINED ZEPHYR_EXECUTORCH_MODULE_DIR)
        target_sources(app PRIVATE
            ${ZEPHYR_EXECUTORCH_MODULE_DIR}/backends/nordic/runtime/AxonBackend.cpp
            ${ZEPHYR_EXECUTORCH_MODULE_DIR}/backends/nordic/runtime/axon_op_extensions.c
        )
    endif()
endif()

# Include app source dirs + generated headers
target_include_directories(app PRIVATE
    ${CMAKE_CURRENT_SOURCE_DIR}/src
    ${CMAKE_CURRENT_SOURCE_DIR}/src/generated
)

# Stub axon_subgraphs_table.h if not generated yet
file(MAKE_DIRECTORY ${CMAKE_CURRENT_SOURCE_DIR}/src/generated)
if(NOT EXISTS ${CMAKE_CURRENT_SOURCE_DIR}/src/generated/axon_subgraphs_table.h)
    file(WRITE ${CMAKE_CURRENT_SOURCE_DIR}/src/generated/axon_subgraphs_table.h
"/* Stub — run export_model.py to generate real AXON subgraph headers. */\n"
"#pragma once\n"
"#include \"axon/nrf_axon_platform.h\"\n"
"#include \"drivers/axon/nrf_axon_nn_infer.h\"\n"
"#define NRF_AXON_MODEL_ALLOCATE_PACKED_OUTPUT_BUFFER 1\n"
"typedef struct {\n"
"    const char *name;\n"
"    const nrf_axon_nn_compiled_model_s *model;\n"
"} axon_subgraph_entry_t;\n"
"#define AXON_SUBGRAPHS_COUNT 0\n"
"static const axon_subgraph_entry_t axon_subgraphs[1] = {{0}};\n")
endif()

# ExecuTorch setup
if(CONFIG_EXECUTORCH)
    if(NOT DEFINED EXECUTORCH_DIR)
        if(DEFINED ZEPHYR_EXECUTORCH_MODULE_DIR)
            set(EXECUTORCH_DIR ${ZEPHYR_EXECUTORCH_MODULE_DIR})
        endif()
    endif()

    set(EXECUTORCH_ROOT ${EXECUTORCH_DIR})
    include(${EXECUTORCH_DIR}/tools/cmake/Utils.cmake)

    # Kernel registry: 27 prim + 2 selective + 19 quantized = 48 → use 64
    target_compile_definitions(app PRIVATE MAX_KERNEL_NUM=64)
    if(TARGET executorch_core)
        target_compile_definitions(executorch_core PRIVATE MAX_KERNEL_NUM=64)
    endif()

    # Link ExecuTorch (provides include paths + core runtime)
    target_link_libraries(app PRIVATE libexecutorch)

    # Portable kernels (for un-delegated ops)
    if(TARGET portable_kernels)
        executorch_target_link_options_shared_lib(portable_kernels)
        target_link_libraries(app PRIVATE portable_kernels)
    endif()

    # Quantized ops (for q/dq at AXON delegation boundaries)
    if(TARGET quantized_ops_lib)
        executorch_target_link_options_shared_lib(quantized_ops_lib)
        target_link_libraries(app PRIVATE quantized_ops_lib)
    endif()
    if(TARGET quantized_kernels)
        executorch_target_link_options_shared_lib(quantized_kernels)
        target_link_libraries(app PRIVATE quantized_kernels)
    endif()
endif()
```

## prj.conf
```kconfig
# Copyright (c) 2026 iote.ai
# SPDX-License-Identifier: BSD-3-Clause
#
# hello_axon — ExecuTorch + AXON NPU inference

# Console / UART
CONFIG_CONSOLE=y
CONFIG_UART_CONSOLE=y
CONFIG_SERIAL=y

# Logging
CONFIG_LOG=y
CONFIG_LOG_DEFAULT_LEVEL=3
CONFIG_LOG_BACKEND_UART=y
CONFIG_LOG_PRINTK=y
CONFIG_PRINTK=y

# Timing (for cycle counting)
CONFIG_TIMING_FUNCTIONS=y

# Float printing
CONFIG_PICOLIBC_IO_FLOAT=y

# Memory
CONFIG_HEAP_MEM_POOL_SIZE=32768
CONFIG_MAIN_STACK_SIZE=16384

# C++ (required by ExecuTorch)
CONFIG_CPP=y
CONFIG_STD_CPP17=y
CONFIG_REQUIRES_FULL_LIBCPP=y

# ExecuTorch
CONFIG_EXECUTORCH=y
CONFIG_EXECUTORCH_ENABLE_LOGGING=y
CONFIG_EXECUTORCH_BUILD_PORTABLE_OPS=n
CONFIG_EXECUTORCH_OPTIMIZE_FOR_SIZE=y
```

## src/main.c
```c
/*
 * Copyright (c) 2026 iote.ai
 * All rights reserved.
 *
 * This source code is licensed under the BSD-style license found in the
 * LICENSE file in the root directory of this source tree.
 *
 * Hello AXON — minimal ExecuTorch + AXON NPU example.
 */

#include <zephyr/kernel.h>
#include <zephyr/logging/log.h>

LOG_MODULE_REGISTER(hello_axon, LOG_LEVEL_INF);

/* Inference runner implemented in C++ (inference.cpp) */
extern int run_inference(void);

int main(void)
{
    LOG_INF("Hello AXON - ExecuTorch + Nordic AXON NPU");
    LOG_INF("Board: %s", CONFIG_BOARD_TARGET);

#if defined(CONFIG_NRF_AXON) && CONFIG_NRF_AXON
    LOG_INF("AXON NPU: enabled");
#else
    LOG_INF("AXON NPU: not available (CPU only)");
#endif

    int ret = run_inference();
    if (ret != 0) {
        LOG_ERR("Inference failed: %d", ret);
    }

    return 0;
}
```

## src/inference.cpp
```c
/*
 * Copyright (c) 2026 iote.ai
 * All rights reserved.
 *
 * This source code is licensed under the BSD-style license found in the
 * LICENSE file in the root directory of this source tree.
 *
 * ExecuTorch inference runner for hello_axon.
 *
 * Loads an embedded .pte model, runs inference, prints output.
 * If the model has AXON-delegated subgraphs, those run on the NPU
 * automatically via the AxonBackend delegate.
 */

#include <cstdint>
#include <cstring>

#include <zephyr/kernel.h>
#include <zephyr/timing/timing.h>

#include <executorch/runtime/executor/program.h>
#include <executorch/runtime/executor/method.h>
#include <executorch/runtime/executor/memory_manager.h>
#include <executorch/runtime/core/exec_aten/exec_aten.h>
#include <executorch/extension/data_loader/buffer_data_loader.h>
#include <executorch/runtime/platform/log.h>

/* The .pte model embedded as a C array.
 * Generated by export_model.py → src/model_pte.h
 */
#include "model_pte.h"

namespace et = executorch::runtime;
using et::Error;
using et::EValue;
using et::HierarchicalAllocator;
using et::MemoryAllocator;
using et::MemoryManager;
using et::Method;
using et::Program;
using et::Result;
using et::Span;
using executorch::extension::BufferDataLoader;
using exec_aten::ScalarType;
using exec_aten::Tensor;
using exec_aten::TensorImpl;

/* Static memory pools */
static uint8_t method_allocator_pool[16 * 1024];
static uint8_t planned_memory_pool[16 * 1024];
static uint8_t temp_allocator_pool[4 * 1024];

extern "C" int run_inference(void)
{
    if (model_pte_len == 0) {
        ET_LOG(Error, "No model embedded. Run: ./setup_export_env.sh && ./run_export.sh");
        return -1;
    }

    ET_LOG(Info, "Loading model (%u bytes)...", model_pte_len);

    BufferDataLoader loader(model_pte, model_pte_len);
    Result<Program> program = Program::load(&loader);
    if (!program.ok()) {
        ET_LOG(Error, "Program::load failed: 0x%x",
               static_cast<uint32_t>(program.error()));
        return -1;
    }
    ET_LOG(Info, "Program loaded, %zu method(s)", program->num_methods());

    const char *method_name = nullptr;
    {
        auto name_result = program->get_method_name(0);
        if (!name_result.ok()) {
            ET_LOG(Error, "No methods in program");
            return -2;
        }
        method_name = *name_result;
    }
    ET_LOG(Info, "Method: %s", method_name);

    /* Memory management */
    MemoryAllocator method_allocator(
        sizeof(method_allocator_pool), method_allocator_pool);
    MemoryAllocator temp_allocator(
        sizeof(temp_allocator_pool), temp_allocator_pool);

    auto method_meta = program->method_meta(method_name);
    if (!method_meta.ok()) {
        ET_LOG(Error, "Failed to get method meta");
        return -3;
    }

    Span<uint8_t> planned_span(planned_memory_pool,
                               sizeof(planned_memory_pool));
    HierarchicalAllocator planned_allocator({&planned_span, 1});
    MemoryManager memory_manager(
        &method_allocator, &planned_allocator, &temp_allocator);

    Result<Method> method = program->load_method(
        method_name, &memory_manager);
    if (!method.ok()) {
        ET_LOG(Error, "load_method failed: 0x%x",
               static_cast<uint32_t>(method.error()));
        return -4;
    }
    ET_LOG(Info, "Method loaded");

    /* Prepare input: single float value */
    float input_data[1] = {1.57f};  /* pi/2 — sin should be ~1.0 */
    Tensor::SizesType input_sizes[] = {1, 1};
    Tensor::DimOrderType input_dim_order[] = {0, 1};
    TensorImpl input_impl(
        ScalarType::Float, 2, input_sizes, input_data, input_dim_order);
    Tensor input_tensor(&input_impl);

    Error err = method->set_input(input_tensor, 0);
    if (err != Error::Ok) {
        ET_LOG(Error, "set_input failed: 0x%x", static_cast<uint32_t>(err));
        return -5;
    }

    /* Run inference.
     * Use timing.h API for true CPU cycles — k_cycle_get_32() on this
     * board ticks at 1 MHz (system clock), not 128 MHz (DWT). */
    timing_init();
    timing_start();

    ET_LOG(Info, "Running inference (x=1.57, expected sin~1.0)...");

    timing_t t_start = timing_counter_get();
    err = method->execute();
    timing_t t_end = timing_counter_get();

    if (err != Error::Ok) {
        ET_LOG(Error, "execute failed: 0x%x", static_cast<uint32_t>(err));
        return -6;
    }

    uint64_t cycles = timing_cycles_get(&t_start, &t_end);
    uint64_t ns = timing_cycles_to_ns(cycles);
    ET_LOG(Info, "Inference: %llu cycles (%llu us @ 128 MHz)",
           (unsigned long long)cycles, (unsigned long long)(ns / 1000));

    /* Read output */
    const EValue &output = method->get_output(0);
    if (output.isTensor()) {
        const auto &out_tensor = output.toTensor();
        if (out_tensor.scalar_type() == ScalarType::Float) {
            const float *data = out_tensor.const_data_ptr<float>();
            for (int i = 0; i < out_tensor.numel() && i < 10; i++) {
                ET_LOG(Info, "  output[%d] = %f", i,
                       static_cast<double>(data[i]));
            }
        }
    }

    ET_LOG(Info, "Done.");
    return 0;
}
```
