## examples/espressif/camera_stream/main/Kconfig.projbuild
```kconfig
# Copyright 2026 Mwaniki Njagi.
# All rights reserved.
#
# This source code is licensed under the BSD-style license found in the
# LICENSE file in the root directory of this source tree.
#
# SPDX-License-Identifier: BSD-3-Clause

menu "Camera inference stream"

    config CAMERA_STREAM_MODEL
        string "ExecuTorch program (.pte) to embed; absolute or relative to this project"
        default "models/mobilenet_v3_small_224.pte"


    choice CAMERA_STREAM_PINOUT
        prompt "Camera module pinout"
        default CAMERA_STREAM_PINOUT_S3_EYE

        config CAMERA_STREAM_PINOUT_S3_EYE
            bool "ESP32-S3-EYE, Freenove ESP32-S3-WROOM CAM, ESP32-S3-CAM N16R8"

        config CAMERA_STREAM_PINOUT_XIAO_SENSE
            bool "Seeed XIAO ESP32S3 Sense"
    endchoice

    config CAMERA_STREAM_SENSOR_JPEG
        bool "Capture JPEG from the sensor (decode on the ESP32 for inference)"
        default y
        help
            JPEG frames are about 15 times smaller than RGB565, so the camera
            DMA does not compete with inference for PSRAM bandwidth and the
            preview needs no software encoder. Turn off to capture RGB565.

    config CAMERA_STREAM_SENSOR_JPEG_QUALITY
        int "Sensor JPEG quality (0 to 63, lower is better)"
        range 4 63
        default 12
        depends on CAMERA_STREAM_SENSOR_JPEG

    config CAMERA_STREAM_XCLK_MHZ
        int "Camera XCLK frequency in MHz"
        range 6 24
        default 10
        help
            At 20 MHz an OV3660 on the ESP32-S3 CAM boards drops and corrupts
            frames after a while (NO-SOI, frame timeouts, dark frames).
            10 MHz is stable and still gives a 12 fps preview.

    config CAMERA_STREAM_PREVIEW
        bool "Stream JPEG preview frames alongside the results"
        default y

    config CAMERA_STREAM_PREVIEW_QUALITY
        int "Preview JPEG quality (1 to 100, higher is better)"
        range 1 100
        default 50
        depends on CAMERA_STREAM_PREVIEW

    config CAMERA_STREAM_PREVIEW_MAX_FPS
        int "Preview frame rate limit"
        range 1 60
        default 15
        depends on CAMERA_STREAM_PREVIEW

    config CAMERA_STREAM_VFLIP
        bool "Flip the image vertically"
        default n

    config CAMERA_STREAM_HMIRROR
        bool "Mirror the image horizontally"
        default n

endmenu
```

## examples/espressif/camera_stream/sdkconfig.defaults
```kconfig
CONFIG_IDF_TARGET="esp32s3"
CONFIG_COMPILER_OPTIMIZATION_PERF=y
CONFIG_ESP_DEFAULT_CPU_FREQ_MHZ_240=y
CONFIG_ESPTOOLPY_FLASHSIZE_16MB=y
CONFIG_ESPTOOLPY_FLASHMODE_QIO=y
CONFIG_ESPTOOLPY_FLASHFREQ_80M=y
CONFIG_PARTITION_TABLE_CUSTOM=y
CONFIG_PARTITION_TABLE_CUSTOM_FILENAME="partitions.csv"
CONFIG_SPIRAM=y
CONFIG_SPIRAM_MODE_OCT=y
CONFIG_SPIRAM_SPEED_80M=y
CONFIG_SPIRAM_USE_MALLOC=y
CONFIG_ESP32S3_DATA_CACHE_64KB=y
CONFIG_ESP32S3_DATA_CACHE_LINE_64B=y
CONFIG_ESP32S3_INSTRUCTION_CACHE_32KB=y
CONFIG_ESP_CONSOLE_USB_SERIAL_JTAG=y
CONFIG_ESP_CONSOLE_SECONDARY_NONE=y
CONFIG_ESP_TASK_WDT_TIMEOUT_S=30
```

## examples/espressif/espnn_runner/main/Kconfig.projbuild
```kconfig
# Copyright 2026 Mwaniki Njagi.
# All rights reserved.
#
# This source code is licensed under the BSD-style license found in the
# LICENSE file in the root directory of this source tree.
#
# SPDX-License-Identifier: BSD-3-Clause

menu "ESP-NN runner"

    config ESPNN_RUNNER_BUNDLE
        string "Test bundle to embed (XTB1 int8 graphs or XTP1 .pte programs)"
        default "bundles/op_suite.xtb"
        help
            Absolute, or relative to this project directory.

    config ESPNN_RUNNER_BENCH_ITERATIONS
        int "Timed iterations per model after the correctness check"
        range 0 1000
        default 10

    config ESPNN_RUNNER_VERIFY_ANSI
        bool "Also run each int8 graph once with the ESP-NN ANSI reference kernels"
        default y

    config ESPNN_RUNNER_DUAL_CORE
        bool "Split ESP-NN kernels across both cores (int8 graphs)"
        default n
        depends on !FREERTOS_UNICORE

    config ESPNN_RUNNER_CONSTANTS_TO_PSRAM
        bool "Copy int8 graph weights from flash into PSRAM when they fit"
        default y
        depends on SPIRAM

    config ESPNN_RUNNER_METHOD_POOL_KB
        int "ExecuTorch method allocator pool (KB)"
        default 1024
        depends on ESPNN_EXECUTORCH_DELEGATE

    config ESPNN_RUNNER_TEMP_POOL_KB
        int "ExecuTorch temporary allocator pool (KB)"
        default 512
        depends on ESPNN_EXECUTORCH_DELEGATE

    config ESPNN_RUNNER_STACK_KB
        int "Runner task stack (KB)"
        default 48 if ESPNN_EXECUTORCH_DELEGATE
        default 16

endmenu
```

## examples/espressif/espnn_runner/sdkconfig.defaults
```kconfig
CONFIG_COMPILER_OPTIMIZATION_PERF=y
CONFIG_ESP_DEFAULT_CPU_FREQ_MHZ_240=y
CONFIG_PARTITION_TABLE_CUSTOM=y
CONFIG_PARTITION_TABLE_CUSTOM_FILENAME="partitions_4mb.csv"
CONFIG_ESPTOOLPY_FLASHSIZE_4MB=y
CONFIG_SPIRAM=y
CONFIG_SPIRAM_IGNORE_NOTFOUND=y
CONFIG_SPIRAM_USE_MALLOC=y
CONFIG_SPIRAM_MALLOC_ALWAYSINTERNAL=16384
CONFIG_SPIRAM_MALLOC_RESERVE_INTERNAL=32768
CONFIG_ESP_TASK_WDT_TIMEOUT_S=30
```

## examples/espressif/espnn_runner/sdkconfig.defaults.esp32
```kconfig
CONFIG_ESPTOOLPY_FLASHSIZE_4MB=y
CONFIG_ESPTOOLPY_FLASHFREQ_40M=y
CONFIG_PARTITION_TABLE_CUSTOM_FILENAME="partitions_4mb.csv"
CONFIG_SPIRAM_TYPE_AUTO=y
CONFIG_SPIRAM_SPEED_40M=y
```

## examples/espressif/espnn_runner/sdkconfig.defaults.esp32s3
```kconfig
CONFIG_ESPTOOLPY_FLASHSIZE_16MB=y
CONFIG_ESPTOOLPY_FLASHMODE_QIO=y
CONFIG_ESPTOOLPY_FLASHFREQ_80M=y
CONFIG_PARTITION_TABLE_CUSTOM_FILENAME="partitions_16mb.csv"
CONFIG_SPIRAM_MODE_OCT=y
CONFIG_SPIRAM_SPEED_80M=y
CONFIG_ESP32S3_DATA_CACHE_64KB=y
CONFIG_ESP32S3_DATA_CACHE_LINE_64B=y
CONFIG_ESP32S3_INSTRUCTION_CACHE_32KB=y
```

## examples/espressif/idf_component_consumer/main/Kconfig.projbuild
```kconfig
menu "ExecuTorch component consumer"

    config ET_CONSUMER_MODEL
        string "Models to run from ET_CONSUMER_MODELS_DIR"
        default "smoke"
        help
            With ET_CONSUMER_MODELS_DIR, the app runs each model of this
            semicolon-separated list from it: <name>.pte, checked against
            <name>.io. Their kernel bundle is the list's names joined by
            underscores, then _kernels, such as smoke_mul_kernels.

endmenu
```
