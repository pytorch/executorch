## backends/espressif/espnn_runtime/Kconfig
```kconfig
# Copyright 2026 Mwaniki Njagi.
# All rights reserved.
#
# This source code is licensed under the BSD-style license found in the
# LICENSE file in the root directory of this source tree.
#
# SPDX-License-Identifier: BSD-3-Clause

menu "ExecuTorch ESP-NN backend"

    config ESPNN_DELEGATE_CONSTANTS_TO_PSRAM
        bool "Copy delegate weights from flash into PSRAM when they fit"
        default y
        depends on SPIRAM

    config ESPNN_DELEGATE_DUAL_CORE
        bool "Split ESP-NN kernels across both cores inside delegates"
        default n

    config ESPNN_DELEGATE_SCRATCH_IN_ARENA
        bool "Plan ESP-NN scratch inside each delegate's activation arena"
        default n
        help
            Gives each operator's ESP-NN scratch a slot in the activation
            arena that is live only while the operator runs, instead of a
            separate buffer sized for the largest operator. This saves
            internal RAM for small models whose arena fits there; for a model
            whose arena goes to PSRAM, the scratch moves to PSRAM too, which
            is slower.

    config ESPNN_DELEGATE_PROFILE
        bool "Print a per-operator profile after each delegate's first run"
        default n
        help
            Times every operator, which adds a timer read per operator to
            each execute. Without it, the delegate reads the timer only
            every few operators, for its cooperative yield.

endmenu
```
